/*
 * Copyright (C) 2013 Texas Instruments Incorporated - http://www.ti.com/
 *
 * This program is free software; you can redistribute it and/or modify
 * it under the terms of the GNU General Public License version 2 as
 * published by the Free Software Foundation.
 */

/* AM437x GP EVM */

#include "mb-method-common.dtsi"

// For Pin Mux Modes, refer to the TI AM437x Processors Datasheet (am4376.pdf)

/ {
	compatible = "ti,am4372", "ti,am43", "ti,cpsw";

	/* The main 5V supply */
	v5_main: fixedregulator-v5_main {
		compatible = "regulator-fixed";
		regulator-name = "v5_main";
		regulator-min-microvolt = <5000000>;
		regulator-max-microvolt = <5000000>;
		vin-supply = <&vpsu_hiv>;
		gpio = <&gpio4 10 GPIO_ACTIVE_HIGH>; /* (AC23) cam1_vd BUCK-5V-EN */
		enable-active-high;
	};

	v5_main_consumer: mb-v5_main-consumer {
		compatible = "mb,reg-th-consumer";
		regulator-name = "mb-v5_main-regulator";
		regulator-boot-on;
		regulator-supplies = "v5_main";
	};
};
