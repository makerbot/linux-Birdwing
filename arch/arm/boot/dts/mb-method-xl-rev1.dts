/*
 * Copyright (C) 2013 Texas Instruments Incorporated - http://www.ti.com/
 *
 * This program is free software; you can redistribute it and/or modify
 * it under the terms of the GNU General Public License version 2 as
 * published by the Free Software Foundation.
 */

/* AM437x GP EVM */

/dts-v1/;

#include "mb-method-rev1-common.dtsi"

// For Pin Mux Modes, refer to the TI AM437x Processors Datasheet (am4376.pdf)

/ {
	model = "MakerBot Method XL GEN-2";
	compatible = "makerbot,method-rev1", "ti,am4372", "ti,am43", "ti,cpsw";

	// magma does not use filament bays
	/delete-node/v3_3_aa;
	/delete-node/v3_3_aa_consumer;
	/delete-node/v3_3_bb;
	/delete-node/v3_3_bb_consumer;
};

&am43xx_pinmux {
	// magma does not use processor chamber PWM
	/delete-property/ehrpwm3_pins;

	mxl_pins: mxl_pins {
		pinctrl-single,pins = <
			0x218 (PIN_OUTPUT_PULLUP | MUX_MODE7) /* (AE19) cam0_data4.gpio4_26 MOBO-USB-HUB-GRSTz */
			0x21C (PIN_OUTPUT_PULLUP | MUX_MODE7) /* (AD19) cam0_data5.gpio4_27 DRGN-HEAT-EN-OUT */
			0x100 (PIN_INPUT_PULLUP | MUX_MODE6) /* (D1) mmc0_clk.pr0_pru0_gpo12 ENDSTOP-Z-BOT (Method-XL) */
		>;
	};
};

// GEN-1 has 12.5 pF capacitance on RTC
// GEN-2 has 7 pF capacitance on RTC
&rtc_sys {
	quartz-load-femtofarads = <7000>;
};
