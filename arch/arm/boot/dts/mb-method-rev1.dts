/*
 * Copyright (C) 2013 Texas Instruments Incorporated - http://www.ti.com/
 *
 * This program is free software; you can redistribute it and/or modify
 * it under the terms of the GNU General Public License version 2 as
 * published by the Free Software Foundation.
 */

/* AM437x GP EVM */

/dts-v1/;

#include "mb-method-rev1-common.dtsi"

// For Pin Mux Modes, refer to the TI AM437x Processors Datasheet (am4376.pdf)

/ {
	model = "MakerBot Method/Method X GEN-2";
	compatible = "makerbot,method-rev1", "ti,am4372", "ti,am43", "ti,cpsw";
};

// GEN-1 has 12.5 pF capacitance on RTC
// GEN-2 has 7 pF capacitance on RTC
&rtc_sys {
	quartz-load-femtofarads = <7000>;
};

// Method/Method-X use motherboard PWM for chamber heating
&epwmss3 {
	status = "okay";
	ehrpwm3: pwm@48306200 {
		status = "okay";
	};
};
